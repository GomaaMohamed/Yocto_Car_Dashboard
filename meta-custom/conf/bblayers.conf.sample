## meta-custom/conf/bblayers.conf.sample
```bitbake
# POKY_BBLAYERS_CONF_VERSION is increased each time build/conf/bblayers.conf
# changes incompatibly
POKY_BBLAYERS_CONF_VERSION = "2"

BBPATH = "${TOPDIR}"
BBFILES ?= ""

BBLAYERS ?= " \
  /home/gomaa/embedded-linux/01-System_Integration/03-Yocto/yocto/poky/meta \
  /home/gomaa/embedded-linux/01-System_Integration/03-Yocto/yocto/poky/meta-poky \
  /home/gomaa/embedded-linux/01-System_Integration/03-Yocto/yocto/poky/meta-yocto-bsp \
  /home/gomaa/embedded-linux/01-System_Integration/03-Yocto/yocto/layers/meta-qt5 \
  /home/gomaa/embedded-linux/01-System_Integration/03-Yocto/yocto/layers/meta-openembedded/meta-oe \
  /home/gomaa/embedded-linux/01-System_Integration/03-Yocto/yocto/layers/meta-custom \
  "
```

## meta-custom/conf/layer.conf
```bitbake
# We have a conf and classes directory, add to BBPATH
BBPATH .= ":${LAYERDIR}"

# We have recipes-* directories, add to BBFILES
BBFILES += "${LAYERDIR}/recipes-*/*/*.bb \
            ${LAYERDIR}/recipes-*/*/*.bbappend"

BBFILE_COLLECTIONS += "meta-custom"
BBFILE_PATTERN_meta-custom = "^${LAYERDIR}/"
BBFILE_PRIORITY_meta-custom = "6"

LAYERDEPENDS_meta-custom = "core"
LAYERSERIES_COMPAT_meta-custom = "kirkstone"
```
